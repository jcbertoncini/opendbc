VERSION ""

NS_ :

BS_:

BU_: XXX

BO_ 1362 NEW_MSG_1: 8 XXX
 SG_ NEW_SIGNAL_1 : 46|6@0+ (1,0) [0|63] "" XXX
 SG_ NEW_SIGNAL_2 : 25|6@1+ (1,0) [0|63] "" XXX

BO_ 1544 NEW_MSG_2: 8 XXX
 SG_ NEW_SIGNAL_1 : 0|2@1+ (1,0) [0|3] "" XXX

BO_ 973 break: 8 XXX
 SG_ break pressure : 45|6@0+ (1,0) [0|63] "" XXX
